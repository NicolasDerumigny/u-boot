## configs/openhwgroup_cv64a6_zcu104_defconfig
```kconfig
CONFIG_RISCV=y
CONFIG_DEFAULT_DEVICE_TREE="cv64a6_zcu104"
CONFIG_TARGET_OPENHWGROUP_CVA6_ZCU104=y
CONFIG_ARCH_RV64I=y
CONFIG_RISCV_SMODE=y
CONFIG_OF_PRIOR_STAGE=y
CONFIG_USE_BOOTCOMMAND=y
CONFIG_SYS_LOAD_ADDR=0x83000000
CONFIG_SYS_BOOTM_LEN=0x2000000
CONFIG_BOOTCOMMAND="mmc info; mmc read ${loadaddr} ${uimage_sector_start} ${uimage_size}; bootm ${loadaddr} - ${fdtcontroladdr};"
CONFIG_DISPLAY_CPUINFO=y
CONFIG_SPL_SPI_FLASH_MTD=y
CONFIG_CMD_GPT=y
# CONFIG_RANDOM_UUID is not set
CONFIG_CMD_MMC=y
CONFIG_CMD_MTD=y
CONFIG_CMD_PART=y
CONFIG_CMD_DHCP=y
CONFIG_CMD_MDIO=y
CONFIG_CMD_PING=y
CONFIG_MMC=y
# CONFIG_MMC_WRITE is not set
CONFIG_MMC_SPI=y
CONFIG_DM_MTD=y
CONFIG_MTD_SPI_NAND=y
CONFIG_SPI_FLASH_ATMEL=y
CONFIG_SPI_FLASH_EON=y
CONFIG_SPI_FLASH_GIGADEVICE=y
CONFIG_SPI_FLASH_ISSI=y
CONFIG_SPI_FLASH_MACRONIX=y
CONFIG_SPI_FLASH_SPANSION=y
CONFIG_SPI_FLASH_STMICRO=y
CONFIG_SPI_FLASH_SST=y
CONFIG_SPI_FLASH_WINBOND=y
CONFIG_SPI_FLASH_XMC=y
# CONFIG_SPI_FLASH_USE_4K_SECTORS is not set
CONFIG_SPI_FLASH_MTD=y
CONFIG_PHY_REALTEK=y
# CONFIG_LOWRISC_DIGILENT_100MHZ is not set
CONFIG_SYS_NS16550=y
CONFIG_SPI=y
CONFIG_XILINX_SPI=y
```
